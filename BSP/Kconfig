## BSP/Kconfig
```kconfig
#support
# Spreadtrum WCN device (NEW )configuration
#
menu "Spreadtrum WCN Device Drivers"

config SC23XX
	bool "SC23XX chip support"
	#depends on MMC
	default y
	help
	  This is support wcn chip for spreadtrum.
	  if you want to use 23xx series wcn chip of spreadtrum.
	  please say "y".

config SC2355
	tristate "SC2355 chip support"
	depends on SC23XX
	default n
	help
	  This is support wcn chip for spreadtrum.
	  If you want to use sc2355 chip of spreadtrum.
	  Please say "y".

config UMW2652
	tristate "UMW2652 chip support"
	depends on SC23XX
	default n
	help
	  This is support wcn chip for spreadtrum.
	  If you want to use umw2652 chip of spreadtrum.
	  Please say "y".

config UMW2653
	tristate "UMW2653 chip support"
	depends on SC23XX
	default n
	help
	  This is support wcn chip for spreadtrum.
	  If you want to use umw2653 chip of spreadtrum.
	  Please say "y".


config SDIOHAL
	tristate "UMW2653 chip support"
	depends on SC23XX
	default n
	help
	  If you want to use SDIOHAL.
	  Please say "y".
	  
config WCN_SLP
	tristate "UMW2653 chip support"
	depends on SC23XX
	default n
	help
	  If you want to use WCN_SLP.
	  Please say "y".

config WCN_BOOT
	tristate "UMW2653 chip support"
	depends on SC23XX
	default y
	help
	  If you want to use WCN_BOOT.
	  Please say "y".	  
	  
config WCN_FIRMWARE_VERIFY
	bool "wcn firmware security verify support"
	default n
	help
	  This is support wcn firmware security verify.
	  if you want to support. 
	  please say "y".
	  Thanks.

config CONFIG_WCN_PARSE_DTS
	bool "Marlin device tree support"
	default n
	help
	  This is support marlin device tree.
	  if you want to support. 
	  please say "y".
	  Thanks.

config THIRD_PARTY_BOARD
	bool "isn't unisoc board support"
	default n
	help
	  This is support wcn chip for other company board.
	  if you want to support other company board.
	  please say "y".
	  Thanks.

config WCN_BSP_DRIVER_BUILDIN
	bool "buildin bsp driver for unisoc chip"
	default n
	help
	  This is support wcn chip for incard board.
	  if you want to buildin bsp driver.
	  please say "y".
	  Thanks.

config RK_BOARD
	bool "rockchip board support"
	default n
	help
	  This is support wcn chip for rockchip board.
	  if you want to support rockchip board.
	  please say "y".
	  Thanks.
	  
config QCOM_BOARD
	bool "Qualcomm board support"
	default n
	help
	  This is support wcn chip for Qualcomm board.
	  if you want to support Qualcomm board.
	  please say "y".
	  Thanks.
	  
# sprd's SDIO device driver based on SC2355...,etc
#source "drivers/misc/sprdwcn/sdio/Kconfig"

# sprd's SIPC device driver based on SC2342 integ...,etc
#source "drivers/misc/sprdwcn/sipc/Kconfig"

# sprd's sleep device driver based on SC2355...,etc
#source "drivers/misc/sprdwcn/sleep/Kconfig"

# sprd's PCIe device driver based on SC2355...,etc
#source "drivers/misc/sprdwcn/pcie/Kconfig"

# sprd's wcn platform driver based on SC2355/SC2342...,etc
#source "drivers/misc/sprdwcn/platform/Kconfig"

# sprd's USB device driver based on SC2355...,etc
#source "drivers/misc/sprdwcn/usb/Kconfig"

endmenu
```

## BT/Kconfig
```kconfig
config TTY_OVERY_SDIO
	tristate "Spard TTY Overy SDIO Driver"
	default m
	---help---
	  Spard tty overy sdio driver.
```
